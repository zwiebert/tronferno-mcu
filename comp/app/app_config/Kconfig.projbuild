## comp/app/app_config/Kconfig.projbuild
```kconfig
menu "Tronferno Project Configuration"

    config APP_USE_JSON
        bool "Compile with JSON support"
        default y

    config APP_USE_POSIX_TIME
        bool "Compile with Posix time support"
        default y

    config APP_USE_OTA
        bool "Compile with over-the-air update support"
        default y

    config APP_USE_WS
        bool "Compile with web socket support"
        default y

    config APP_USE_MUTEX
        bool "Compile with MUTEX support"
        default y
        help
            If disabled, use a dummy instead of a real Mutex
            Note: Disable it only for testing/debugging purposes

    config APP_USE_CLI_TASK
        bool "Run CLI in its own task"
        default y

    config APP_USE_ESP_GET_TIME
        bool "Get up-time from esp_timer_get_time()"
        default y
        help
            Don't count up-time in our own timer-ISR.
            Use esp_timer_get_time() instead

    config APP_USE_GPIO_PINS
        bool "Compile with support for user defined GPIOs"
        default y
        help
            The user can define GPIOs from CLI/web-app, which then can be read or set via MQTT

    config APP_USE_FREERTOS
        bool "Compile FreeRTOS-dependent code in common modules"
        default y

    config APP_USE_MDR_TIME
        bool "Compile support for MDR time library (obsolete)"
        default n

    config APP_USE_TIMER_TASK
        bool "Split timer ISR into ISR and high priority task"
        default n
        help
            Instead of calling the RF-transceiver tick functions directly from timer ISR,
            move these calls to a high priority task, and only do sampling
            and setting the GPIO RX/TX pins in the ISR

    config APP_MQTT_CLIENT_ID
        string "Default ID of MQTT client"
        default "tfmcu"

    config APP_MQTT_ROOT_TOPIC
        string "Default root topic of MQTT client"
        default "tfmcu"

    config APP_GEO_TZ
        string "POSIX TZ string"
        default "CET-1CEST-2,M3.5.0,M10.5.0"

    config APP_SETTINGS_PASSWORD
        string "password for MCU settings"
        default ""

    config APP_FER_CENTRAL_UNIT_ID
        hex "Default ID of programming centre"
        default 0x801234

    config APP_FER_GM_USE
        hex "Default active groups/receivers"
        default 0x7777777

    config APP_WIFI_AP_SSID
        string "WIFI/WLAN access-point SSID"
        default "tronferno"

    config APP_WIFI_AP_PASSWORD
        string "WIFI/WLAN access-point password"
        default "tronferno"


endmenu
```

## comp/config/app_config/Kconfig.projbuild
```kconfig
menu "Tronferno Project Configuration"

    config APP_USE_NETWORK
        bool "Compile NETWORK support"
        default y

    config APP_USE_HTTP
        depends on APP_USE_NETWORK
        bool "Compile HTTP server "
        default y

    config APP_USE_HTTP_SERVE_JS_MAP
        depends on APP_USE_HTTP
        bool "Serve wapp.js.map file"
        default y

    config APP_USE_HTTP_SERVE_CSS_MAP
        depends on APP_USE_HTTP
        bool "Serve wapp.css.map file"
        default n

    config APP_USE_WS
        depends on APP_USE_HTTP
        bool "Compile with Websocket support"
        default y

    config APP_USE_MQTT
        bool "Compile MQTT client"
        default y

    config APP_MQTT_CLIENT_ID
        string
        default "tfmcu"

    config APP_MQTT_ROOT_TOPIC
        string
        default "tfmcu"

    config APP_USE_OTA
        depends on APP_USE_NETWORK
        bool "Compile with over-the-air update support"
        default y

    config APP_OTA_URL_HEAD
        depends on APP_USE_OTA
        string "Firmware URL for repository"
        default "https://raw.githubusercontent.com/zwiebert/tronferno-mcu-bin/"

    config APP_OTA_URL_TAIL
        depends on APP_USE_OTA
        string "Firmware URL file path after branch or tag name"
        default "/firmware/esp32/tronferno-mcu.bin"

    config APP_USE_POSIX_TIME
        bool "Compile with Posix time support"
        default y

    config APP_USE_MUTEX
        bool "Compile with MUTEX support"
        default y
        help
            If disabled, use a dummy instead of a real Mutex
            Note: Disable it only for testing/debugging purposes

    config APP_USE_ESP_GET_TIME
        bool "Get up-time from esp_timer_get_time()"
        default y
        help
            Don't count up-time in our own timer-ISR.
            Use esp_timer_get_time() instead

    config APP_USE_GPIO_PINS
        bool "Compile with support for user defined GPIOs"
        default y
        help
            The user can define GPIOs from CLI/web-app, which then can be read or set via MQTT

    config APP_USE_TIMER_TASK
        bool "Split timer ISR into ISR and high priority task"
        default n
        help
            Instead of calling the RF-transceiver tick functions directly from timer ISR,
            move these calls to a high priority task, and only do sampling
            and setting the GPIO RX/TX pins in the ISR

    config APP_GEO_TZ
        string "POSIX TZ string"
        default "CET-1CEST-2,M3.5.0,M10.5.0"

    config APP_SETTINGS_PASSWORD
        string "password for MCU settings"
        default ""

    config APP_FER_CENTRAL_UNIT_ID
        hex "Default ID of programming centre"
        default 0x801234

    config APP_FER_GM_USE
        hex "Default active groups/receivers"
        default 0x7777777

    config APP_WIFI_AP_SSID
        string "WIFI/WLAN access-point SSID"
        default "tronferno"

    config APP_WIFI_AP_PASSWORD
        string "WIFI/WLAN access-point password"
        default "tronferno"

    config APP_CFG_NAMESPACE
        string "Namespace for kvs configuration storage"
        default "Tronferno"
        help
            Note: When changed, the previous configuration data will become inacessible

    config APP_GPIO_NUMBER_OF_GPIOS
        int "Number of available GPIOs"
        default 40
        help
            Number of GPIOs this MCU has (ESP32: 40)

    config MAIN_LOOP_PERIOD_MS
        int "main loop period in milliseconds"
        default 100
        help
            How frequently the main loop is called by timer

    config NETWORK_CHECK_LOOP_PERIOD_S
        int "network check loop period in seconds"
        default 15
        help
            How frequently the network connection is checked for appearing while disconnected

endmenu
```

## comp/library/fernotron_app/Kconfig
```kconfig
menu "zwiebert: Tronferno App Library"
    
config APP_USE_CUAS
  bool "Activate CUAS"
  default y

config APP_USE_SEP
  bool "Activate SEP"
  default y
  
config APP_USE_TIMER_DATA_FS
  bool "Activate USE_TIMER_DATA_FS"
  default n
  
config APP_USE_TIMER_DATA_KVS
  bool "Activate USE_TIMER_DATA_KVS"
  default y
 
 config APP_USE_PAIRINGS
  bool "Activate USE_PAIRINGS"
  default y 
 
 
 endmenu
```

## comp/library/fernotron_trx/Kconfig
```kconfig
menu "zwiebert: Tronferno Transceiver"

    config APP_USE_FER_TRANSMITTER
        bool "Activate FER_TRANSMITTER"
        default y

    config APP_USE_FER_RECEIVER
        bool "Activate FER_RECEIVER"
        default y

    config TRONFERNO_TRX_DEBUG
      bool "Enable debug messages"
      default n

endmenu
```

## comp/library/fernotron_uout/Kconfig
```kconfig
menu "zwiebert: Tronferno UOUT"

    config TRONFERNO_PUBLISH_PCT_AS_TXT
        bool "publish PCT (also) as text in terminal"
        default n
        help
            We now publish messages in JSON format.  The plain text format is for backwards
            compatibility with old versions for FHEM tronferno_mcu module and Android app

    config TRONFERNO_PUBLISH_TRX_AS_TXT
        bool "publish sent/received RF messages (also) as text in terminal"
        default n
        help
            We now publish messages in JSON format.  The plain text format is for backwards
            compatibility with old versions for FHEM tronferno_mcu module and Android app

    config FERNOTRON_UOUT_DEBUG
      bool "Enable debug messages"
      default n

endmenu
```

## src/components/app_config/Kconfig.projbuild
```kconfig
menu "Tronferno Project Configuration"
    
config TF_USE_HTTP
  bool "Activate HTTP"
  default y

config TF_USE_LAN
  bool "Activate LAN"
  default y

config TF_USE_WLAN
  bool "Activate WLAN"
  default y

config TF_USE_WLAN_AP
  bool "Activate WLAN_AP"
  default y

config TF_USE_NTP
  bool "Activate NTP"
  default y
 
config TF_USE_JSON
  bool "Activate JSON"
  default y

config TF_USE_MQTT
  bool "Activate MQTT"
  default y

config TF_USE_POSIX_TIME
  bool "Activate POSIX_TIME"
  default y

config TF_USE_SERIAL
  bool "Activate SERIAL"
  default y

config TF_USE_WDG
  bool "Activate WDG"
  default y

config TF_USE_FS
  bool "Activate FS"
  default y

config TF_USE_HTTP_CLIENT
  bool "Activate HTTP_CLIENT"
  default y

config TF_USE_OTA
  bool "Activate OTA"
  default y

config TF_USE_STM32OTA
  bool "Activate STM32OTA"
  default y

config TF_USE_CUAS
  bool "Activate CUAS"
  default n

config TF_USE_TCPS
  bool "Activate TCPS (non task)"
  default n
    
config TF_USE_TCPS_TASK
  bool "Activate TCPS_TASK"
  default y

config TF_USE_EG
  bool "Activate EG"
  default y

config TF_USE_SEP
  bool "Activate SEP"
  default y

config TF_USE_WS
  bool "Activate WS"
  default y

config TF_USE_CLI_MUTEX
  bool "Activate CLI_MUTEX"
  default y

config TF_USE_CLI_TASK
  bool "Activate CLI_TASK"
  default y

config TF_USE_TXTIO_MUTEX
  bool "Activate TXTIO_MUTEX"
  default y
    
config TF_USE_NETWORK
  bool "Activate NETWORK"
  default y

config TF_USE_AP_FALLBACK
  bool "Activate AP_FALLBACK"
  default y
  
  
config TF_USE_CONFIG_KVS
  bool "Activate CONFIG_KVS"
  default y
  
config TF_USE_ESP_GET_TIME
  bool "Activate ESP_GET_TIME"
  default y

config TF_USE_FER_TRANSMITTER
  bool "Activate FER_TRANSMITTER"
  default y
 
config TF_USE_FER_RECEIVER
  bool "Activate FER_RECEIVER"
  default y

config TF_USE_PAIRINGS
  bool "Activate USE_PAIRINGS"
  default y 
 
config TF_USE_GPIO_PINS
  bool "Activate USE_GPIO_PINS"
  default y 
 
config TF_USE_TIMER_DATA_FS
  bool "Activate USE_TIMER_DATA_FS"
  default n
  
config TF_USE_TIMER_DATA_KVS
  bool "Activate USE_TIMER_DATA_KVS"
  default y
 
config TF_USE_FREERTOS
  bool "Activate USE_FREERTOS"
  default y

config TF_USE_MDR_TIME
  bool "Activate USE_MDR_TIME"
  default n
  
  endmenu
```

## src/esp32/main/Kconfig.projbuild
```kconfig
menu "TronfernoMCU Configuration"

config MY_WIFI_SSID
    string "WiFi SSID"
	default ""
	help
		SSID (network name) for the example to connect to.

config MY_WIFI_PASSWORD
    string "WiFi Password"
	default ""
	help
		WiFi password (WPA or WPA2) for the example to use.

		Can be left blank if the network has no security set.

config MY_MQTT_ENABLE
    bool "Enable MQTT client"
    default n

config MY_MQTT_URL
    string "URL of MQTT Server to connect"
	default ""

config MY_MQTT_USER
    string "User Name for MQTT Server connect"
	default ""

config MY_MQTT_PASSWORD
    string "Password for MQTT Server connect"
	default ""

config MY_HTTP_ENABLE
    bool "Enable HTTP server"
    default n

config MY_HTTP_USER
    string "Optional User Name for HTTP Server Login"
	default ""

config MY_HTTP_PASSWORD
    string "Optional Password for HTTP Server Login"
	default ""

config MY_FER_CENTRAL_UNIT_ID
    hex "Fernotron Central Unit ID"
	default 0x8012345
		
config MY_MCU_UART_BAUD_RATE
	int "MCU UART baud rate"
	default 115200

config MY_GEO_TZ
	string "time zone in POSIX TZ format"
	default "CET-1CEST-2,M3.5.0,M10.5.0"
	help
		required for programming the shutter's internal clock with localtime and daylight-saving status"
	
config MY_GEO_TIMEZONE
	int "normal (not DST) time zone as hour offset to UTC/GMT"
	default 1
	help
		used to calculate twilight time tabels required by shutters astro function

 	
endmenu
```

## src/esp32/sdkconfig.defaults
```kconfig
CONFIG_BOOTLOADER_LOG_LEVEL=2
CONFIG_BOOTLOADER_LOG_LEVEL_INFO=n
CONFIG_BOOTLOADER_LOG_LEVEL_WARN=y
CONFIG_BOOTLOADER_SPI_WP_PIN=7
CONFIG_COMPILER_OPTIMIZATION_ASSERTIONS_SILENT=y
CONFIG_COMPILER_OPTIMIZATION_LEVEL_RELEASE=y
CONFIG_COMPILER_OPTIMIZATION_PERF=y
CONFIG_ESP32_DEFAULT_CPU_FREQ_160=
CONFIG_ESP32_DEFAULT_CPU_FREQ_240=y
CONFIG_ESP32_DEFAULT_CPU_FREQ_MHZ=240
CONFIG_ESP32_WIFI_TASK_PINNED_TO_CORE_1=y
CONFIG_ESP_MAC_ADDR_UNIVERSE_ETH=y
CONFIG_ESP_MAIN_TASK_STACK_SIZE=4096
CONFIG_ESP_SYSTEM_EVENT_TASK_STACK_SIZE=2048
CONFIG_ESPTOOLPY_FLASHSIZE_2MB=
CONFIG_ESPTOOLPY_FLASHSIZE="4MB"
CONFIG_ESPTOOLPY_FLASHSIZE_4MB=y
CONFIG_ETH_DMA_BUFFER_SIZE=512
CONFIG_ETH_DMA_RX_BUFFER_NUM=10
CONFIG_ETH_DMA_TX_BUFFER_NUM=10
CONFIG_ETH_ENABLED=y
CONFIG_ETH_PHY_INTERFACE_RMII=y
CONFIG_ETH_RMII_CLK_OUT_GPIO=17
CONFIG_ETH_RMII_CLK_OUTPUT=y
CONFIG_ETH_USE_ESP32_EMAC=y
CONFIG_ETH_USE_SPI_ETHERNET=y
CONFIG_FREERTOS_CHECK_STACKOVERFLOW_CANARY=
CONFIG_FREERTOS_CHECK_STACKOVERFLOW_PTRVAL=y
CONFIG_FREERTOS_HZ=1000
CONFIG_FREERTOS_IDLE_TASK_STACKSIZE=1024
CONFIG_FREERTOS_THREAD_LOCAL_STORAGE_POINTERS=3
CONFIG_HTTPD_MAX_REQ_HDR_LEN=1024
CONFIG_HTTPD_MAX_URI_LEN=128
CONFIG_HTTPD_WS_SUPPORT=y
CONFIG_LWIP_ETHARP_TRUST_IP_MAC=y
CONFIG_LWIP_MAX_SOCKETS=12
CONFIG_LWIP_SO_REUSE_RXTOALL=y
CONFIG_LWIP_SO_REUSE=y
CONFIG_MBEDTLS_HARDWARE_MPI=y
CONFIG_MBEDTLS_MPI_USE_INTERRUPT=y
CONFIG_PARTITION_TABLE_CUSTOM=y
CONFIG_PARTITION_TABLE_FILENAME="partitions.csv"
CONFIG_PARTITION_TABLE_SINGLE_APP=
CONFIG_SPIFFS_CACHE=
CONFIG_SPIFFS_USE_MTIME=
```
